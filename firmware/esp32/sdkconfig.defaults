## firmware/esp32c3/sdkconfig.defaults
```kconfig
CONFIG_IDF_TARGET="esp32c3"
CONFIG_ESPTOOLPY_FLASHSIZE_4MB=y
CONFIG_PARTITION_TABLE_CUSTOM=y
CONFIG_PARTITION_TABLE_CUSTOM_FILENAME="partitions.csv"
CONFIG_ESP_DEFAULT_CPU_FREQ_MHZ_160=y
CONFIG_COMPILER_OPTIMIZATION_PERF=y
CONFIG_COMPILER_CXX_EXCEPTIONS=n
CONFIG_COMPILER_CXX_RTTI=n
CONFIG_COMPILER_OPTIMIZATION_ASSERTIONS_SILENT=y
CONFIG_FREERTOS_HZ=1000
CONFIG_FREERTOS_CHECK_MUTEX_GIVEN_BY_OWNER=n
CONFIG_FREERTOS_INTERRUPT_BACKTRACE=n
CONFIG_FREERTOS_ENABLE_TASK_SNAPSHOT=n
CONFIG_BOOTLOADER_LOG_LEVEL_WARN=y

# USB Serial/JTAG 给 DAP 链路和命令行用，UART0 给另一个命令行用（libxr 的 UART 驱动），
# 任何控制台输出都不能走这两个口（否则日志混进 DAP 帧），系统日志控制台全部关闭。
CONFIG_ESP_CONSOLE_NONE=y
CONFIG_ESP_CONSOLE_SECONDARY_NONE=y

# 短周期采样时空闲任务很少能运行，不把它算作看门狗超时。看门狗本身保留（中断看门狗照常工作）。
CONFIG_ESP_TASK_WDT_CHECK_IDLE_TASK_CPU0=n

# 关掉用不到的功能：只用 Wi-Fi STA、IPv4、TCP 客户端连入（与 S3 版相同）
CONFIG_ESP_WIFI_SOFTAP_SUPPORT=n
CONFIG_ESP_WIFI_ENTERPRISE_SUPPORT=n
CONFIG_ESP_WIFI_ENABLE_WPA3_OWE_STA=n
CONFIG_ESP_WIFI_ENABLE_SAE_PK=n
CONFIG_ESP_WIFI_GMAC_SUPPORT=n
CONFIG_ESP_WIFI_NVS_ENABLED=n
CONFIG_LWIP_IPV6=n
CONFIG_LWIP_DHCPS=n
CONFIG_LWIP_NETIF_LOOPBACK=n
CONFIG_LWIP_DNS_SUPPORT_MDNS_QUERIES=n
CONFIG_LWIP_MAX_SOCKETS=4
CONFIG_LWIP_MAX_ACTIVE_TCP=8
CONFIG_LWIP_MAX_LISTENING_TCP=4
# DAP 一问一答，包不超过 1 KB，TCP 缓冲用 16 KB 足够；Wi-Fi 收发缓冲用 IDF 默认值。
CONFIG_LWIP_TCP_SND_BUF_DEFAULT=16384
CONFIG_LWIP_TCP_WND_DEFAULT=16384
```

## firmware/esp32s3/main/Kconfig.projbuild
```kconfig
menu "XR-DAP"

    choice XRDAP_BOARD
        prompt "Board"
        default XRDAP_BOARD_DEFAULT
        help
            Pin assignment of the S3 build. See firmware/esp32s3/main/config.hpp.

        config XRDAP_BOARD_DEFAULT
            bool "ESP32-S3 dev board: SWCLK GPIO5, SWDIO GPIO4, serial link on UART0"

        config XRDAP_BOARD_LITE
            bool "Wireless DAP Lite: SWCLK GPIO37, SWDIO GPIO47 through an SGM3157, no USB-UART"
    endchoice

endmenu
```

## firmware/esp32s3/sdkconfig.defaults
```kconfig
CONFIG_IDF_TARGET="esp32s3"
CONFIG_ESPTOOLPY_FLASHSIZE_8MB=y
CONFIG_PARTITION_TABLE_CUSTOM=y
CONFIG_PARTITION_TABLE_CUSTOM_FILENAME="partitions.csv"
CONFIG_ESP_DEFAULT_CPU_FREQ_MHZ_240=y
CONFIG_COMPILER_OPTIMIZATION_PERF=y
CONFIG_COMPILER_CXX_EXCEPTIONS=n
CONFIG_COMPILER_CXX_RTTI=n
CONFIG_FREERTOS_HZ=1000
CONFIG_ESP_TASK_WDT_CHECK_IDLE_TASK_CPU0=n
CONFIG_ESP_WIFI_TASK_PINNED_TO_CORE_0=y
# 性能相关：QIO Flash、32 KB 指令缓存 / 32 KB 数据缓存（64 KB 数据缓存要多占 32 KB 内部 RAM，堆不够时 lwIP 发包会卡住）、断言静默、lwIP 放 IRAM 并固定在核 0、加大 Wi-Fi 缓冲。
CONFIG_ESPTOOLPY_FLASHMODE_QIO=y
CONFIG_ESP32S3_INSTRUCTION_CACHE_32KB=y
CONFIG_ESP32S3_DATA_CACHE_32KB=y
CONFIG_COMPILER_OPTIMIZATION_ASSERTIONS_SILENT=y
CONFIG_FREERTOS_CHECK_MUTEX_GIVEN_BY_OWNER=n
CONFIG_FREERTOS_INTERRUPT_BACKTRACE=n
CONFIG_LWIP_TCPIP_TASK_AFFINITY_CPU0=y
CONFIG_LWIP_IRAM_OPTIMIZATION=y
CONFIG_LWIP_EXTRA_IRAM_OPTIMIZATION=y
# 参考 ESP-IDF 的 examples/wifi/iperf（S3）：更大的块确认窗口、更大的 lwIP 邮箱，lwIP 任务优先级与 Wi-Fi 任务相同
CONFIG_ESP_WIFI_TX_BA_WIN=32
CONFIG_ESP_WIFI_RX_BA_WIN=32
CONFIG_LWIP_TCP_RECVMBOX_SIZE=64
CONFIG_LWIP_TCPIP_RECVMBOX_SIZE=64
CONFIG_LWIP_TCPIP_TASK_PRIO=23

# 关掉用不到的功能：只用 Wi-Fi STA、IPv4、TCP 客户端连入，不用 SoftAP、企业认证、IPv6、DHCP 服务器
CONFIG_ESP_WIFI_SOFTAP_SUPPORT=n
CONFIG_ESP_WIFI_ENTERPRISE_SUPPORT=n
CONFIG_ESP_WIFI_ENABLE_WPA3_OWE_STA=n
CONFIG_ESP_WIFI_ENABLE_SAE_PK=n
CONFIG_ESP_WIFI_GMAC_SUPPORT=n
CONFIG_ESP_WIFI_NVS_ENABLED=n
CONFIG_LWIP_IPV6=n
CONFIG_LWIP_DHCPS=n
CONFIG_LWIP_NETIF_LOOPBACK=n
CONFIG_LWIP_DNS_SUPPORT_MDNS_QUERIES=n
CONFIG_LWIP_MAX_SOCKETS=4
CONFIG_LWIP_MAX_ACTIVE_TCP=8
CONFIG_LWIP_MAX_LISTENING_TCP=4
CONFIG_FREERTOS_ENABLE_TASK_SNAPSHOT=n
# UART0 给串口 DAP 链路用，系统日志控制台关闭（日志会混进 DAP 帧）
CONFIG_ESP_CONSOLE_NONE=y
CONFIG_ESP_CONSOLE_SECONDARY_NONE=y
# 核 1 专门跑 SWD：短周期采样时空闲任务很少能运行，不把它算作看门狗超时
CONFIG_ESP_TASK_WDT_CHECK_IDLE_TASK_CPU1=n
CONFIG_BOOTLOADER_LOG_LEVEL_WARN=y

# 加大无线收发队列，减少突发流量时的丢包：Wi-Fi 静态/动态接收缓冲、动态发送缓冲、TCP 窗口和发送缓冲
CONFIG_ESP_WIFI_STATIC_RX_BUFFER_NUM=24
CONFIG_ESP_WIFI_DYNAMIC_RX_BUFFER_NUM=128
CONFIG_ESP_WIFI_DYNAMIC_TX_BUFFER_NUM=128
CONFIG_LWIP_TCP_SND_BUF_DEFAULT=32768
CONFIG_LWIP_TCP_WND_DEFAULT=32768
CONFIG_LWIP_TCP_OOSEQ_MAX_PBUFS=8
```

## firmware/esp32sx/main/Kconfig.projbuild
```kconfig
menu "XR-DAP"

    choice XRDAP_BOARD
        prompt "Board"
        default XRDAP_BOARD_S2 if IDF_TARGET_ESP32S2
        default XRDAP_BOARD_DEFAULT
        help
            Pin assignment of the build. See firmware/esp32sx/main/config.hpp.

        config XRDAP_BOARD_DEFAULT
            bool "ESP32-S3 dev board: SWCLK GPIO5, SWDIO GPIO4, serial link on UART0"
            depends on IDF_TARGET_ESP32S3

        config XRDAP_BOARD_LITE
            bool "Wireless DAP Lite: SWCLK GPIO37, SWDIO GPIO47 through an SGM3157, no USB-UART"
            depends on IDF_TARGET_ESP32S3

        config XRDAP_BOARD_S2
            bool "ESP32-S2 board: SWCLK GPIO37, SWDIO GPIO35, nRESET GPIO40, no USB-UART"
            depends on IDF_TARGET_ESP32S2
    endchoice

    config XRDAP_VERSION_SUFFIX
        string "Firmware version suffix"
        default "-preview" if XRDAP_BOARD_S2
        default ""
        help
            Appended to the firmware version in DAP_Info and mDNS. Boards not yet
            tested on hardware use "-preview".

endmenu
```

## firmware/esp32sx/sdkconfig.defaults.s2-boot-diag
```kconfig
# S2 full application with early header UART diagnostics; append after sdkconfig.defaults.
CONFIG_XRDAP_S2_PROFILE_BOOT_DIAG=y
CONFIG_ESP_CONSOLE_NONE=n
CONFIG_ESP_CONSOLE_UART_DEFAULT=n
CONFIG_ESP_CONSOLE_USB_CDC=n
CONFIG_ESP_CONSOLE_USB_SERIAL_JTAG=n
CONFIG_ESP_CONSOLE_UART_CUSTOM=y
CONFIG_ESP_CONSOLE_UART_CUSTOM_NUM_0=y
CONFIG_ESP_CONSOLE_UART_TX_GPIO=42
CONFIG_ESP_CONSOLE_UART_RX_GPIO=41
CONFIG_ESP_CONSOLE_UART_BAUDRATE=115200
CONFIG_ESP_CONSOLE_SECONDARY_NONE=y
CONFIG_BOOTLOADER_LOG_LEVEL_WARN=n
CONFIG_BOOTLOADER_LOG_LEVEL_INFO=y
CONFIG_LOG_DEFAULT_LEVEL_INFO=y
CONFIG_COMPILER_OPTIMIZATION_ASSERTIONS_SILENT=n
CONFIG_COMPILER_OPTIMIZATION_ASSERTIONS_ENABLE=y
CONFIG_ESP_SYSTEM_PANIC_SILENT_REBOOT=n
CONFIG_ESP_SYSTEM_PANIC_PRINT_REBOOT=y
```

## firmware/sdkconfig.defaults
```kconfig
CONFIG_IDF_TARGET="esp32s3"
CONFIG_ESPTOOLPY_FLASHSIZE_8MB=y
CONFIG_ESP_DEFAULT_CPU_FREQ_MHZ_240=y
CONFIG_COMPILER_OPTIMIZATION_PERF=y
CONFIG_COMPILER_CXX_EXCEPTIONS=n
CONFIG_COMPILER_CXX_RTTI=n
CONFIG_FREERTOS_HZ=1000
CONFIG_ESP_TASK_WDT_CHECK_IDLE_TASK_CPU0=n
CONFIG_LWIP_TCP_SND_BUF_DEFAULT=16384
CONFIG_LWIP_TCP_WND_DEFAULT=16384
CONFIG_ESP_WIFI_TASK_PINNED_TO_CORE_0=y
# 性能相关：QIO Flash、32 KB 指令缓存 / 64 KB 数据缓存、断言静默、lwIP 放 IRAM 并固定在核 0、加大 Wi-Fi 缓冲。
CONFIG_ESPTOOLPY_FLASHMODE_QIO=y
CONFIG_ESP32S3_INSTRUCTION_CACHE_32KB=y
CONFIG_ESP32S3_DATA_CACHE_64KB=y
CONFIG_COMPILER_OPTIMIZATION_ASSERTIONS_SILENT=y
CONFIG_FREERTOS_CHECK_MUTEX_GIVEN_BY_OWNER=n
CONFIG_FREERTOS_INTERRUPT_BACKTRACE=n
CONFIG_LWIP_TCPIP_TASK_AFFINITY_CPU0=y
CONFIG_LWIP_IRAM_OPTIMIZATION=y
CONFIG_LWIP_EXTRA_IRAM_OPTIMIZATION=y
CONFIG_ESP_WIFI_STATIC_RX_BUFFER_NUM=16
CONFIG_ESP_WIFI_DYNAMIC_RX_BUFFER_NUM=64
CONFIG_ESP_WIFI_DYNAMIC_TX_BUFFER_NUM=64
# 参考 ESP-IDF 的 examples/wifi/iperf（S3）：更大的块确认窗口、更大的 lwIP 邮箱，lwIP 任务优先级与 Wi-Fi 任务相同
CONFIG_ESP_WIFI_TX_BA_WIN=32
CONFIG_ESP_WIFI_RX_BA_WIN=32
CONFIG_LWIP_TCP_RECVMBOX_SIZE=64
CONFIG_LWIP_TCPIP_RECVMBOX_SIZE=64
CONFIG_LWIP_TCPIP_TASK_PRIO=23
```
